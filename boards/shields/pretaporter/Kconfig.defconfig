## boards/shields/pretaporter/Kconfig.defconfig
```kconfig
if SHIELD_PRETAPORTER_R

config ZMK_KEYBOARD_NAME
    default "pretaporter_r"

config ZMK_SPLIT
    default y

config ZMK_SPLIT_ROLE_CENTRAL
    default y

endif

if SHIELD_PRETAPORTER_L

config ZMK_KEYBOARD_NAME
    default "pretaporter_l"

config ZMK_SPLIT
    default y

endif
```

## boards/shields/pretaporter/Kconfig.shield
```kconfig
config SHIELD_PRETAPORTER_R
    def_bool $(shields_list_contains,pretaporter_r)

config SHIELD_PRETAPORTER_L
    def_bool $(shields_list_contains,pretaporter_l)
```
