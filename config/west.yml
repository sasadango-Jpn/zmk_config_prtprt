## config/west.yml
```yaml
manifest:
  remotes:
    - name: zmkfirmware
      url-base: https://github.com/zmkfirmware
    - name: sasadango-Jpn
      url-base: https://github.com/sasadango-Jpn
    #- name: sasadango-Jpn
    #  url-base: https://github.com/sasadango-Jpn
    #- name: sasadango-Jpn  # <-- RGB LED
    #  url-base: https://github.com/sasadango-Jpn  
  projects:
    - name: zmk
      remote: zmkfirmware
      revision: v0.3
      import: app/west.yml
    - name: zmk-pmw3610-driver
      remote: sasadango-Jpn
      revision: main
    - name: zmk-rgbled-widget
      remote: sasadango-Jpn
      revision: v0.3
  self:
    path: config
    
```
